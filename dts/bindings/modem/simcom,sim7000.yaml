## dts/bindings/modem/simcom,sim7000.yaml
```yaml
# Copyright (C) 2021 metraTec GmbH
# SPDX-License-Identifier: Apache-2.0

description: Simcom Sim7000 modem

compatible: "simcom,sim7000"

include: zephyr,cellular-modem-device.yaml

properties:
  mdm-power-gpios:
    type: phandle-array
    required: true
```
